## platforms/phyCORE-STM32MP1/meta-power-gateway/conf/layer.conf
```bitbake
BBPATH .= ":${LAYERDIR}"
BBFILES += "${LAYERDIR}/recipes-*/*/*.bb \
            ${LAYERDIR}/recipes-*/*/*.bbappend"
BBFILES_DYNAMIC += "stm-st-stm32mp:${LAYERDIR}/dynamic-layers/stm-st-stm32mp/recipes-*/*/*.bbappend"

BBFILE_COLLECTIONS += "phycore-power-gateway"
BBFILE_PATTERN_phycore-power-gateway = "^${LAYERDIR}/"
BBFILE_PRIORITY_phycore-power-gateway = "9"

LAYERSERIES_COMPAT_phycore-power-gateway = "kirkstone"
LAYERDEPENDS_phycore-power-gateway = "core openembedded-layer"
```

## platforms/toradex-verdin-am62/meta-power-gateway/conf/layer.conf
```bitbake
BBPATH .= ":${LAYERDIR}"
BBFILES += "${LAYERDIR}/recipes-*/*/*.bb \
            ${LAYERDIR}/recipes-*/*/*.bbappend"

BBFILE_COLLECTIONS += "power-gateway"
BBFILE_PATTERN_power-gateway = "^${LAYERDIR}/"
BBFILE_PRIORITY_power-gateway = "8"

LAYERSERIES_COMPAT_power-gateway = "scarthgap styhead walnascar"
LAYERDEPENDS_power-gateway = "core openembedded-layer"
```
