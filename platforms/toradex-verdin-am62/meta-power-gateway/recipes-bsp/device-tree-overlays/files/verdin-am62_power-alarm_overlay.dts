/dts-v1/;
/plugin/;

/*
 * M4F owns MCU_GPIO0 bank 0.
 *
 * Alarm input:
 *   Verdin X1/SODIMM 206
 *   AM62 ball B8 / pad MCU_SPI0_CS1
 *   mux mode 7 / MCU_GPIO0_1
 *
 * Pin mux and interrupt-router programming are generated by TI SysConfig in
 * the M4F firmware. Linux must not request this GPIO controller or its bank
 * interrupt.
 */

&mcu_gpio0 {
    status = "reserved";
};

&mcu_gpio_intr {
    status = "reserved";
};

